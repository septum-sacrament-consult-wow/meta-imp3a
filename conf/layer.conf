## conf/layer.conf
```bitbake
# We have a packages directory, add to BBFILES
BBPATH := "${BBPATH}:${LAYERDIR}"

BBFILES += "${LAYERDIR}/recipes*/*/*.bb*"
BBFILES += "${LAYERDIR}/images/*.bb*"

BBFILE_COLLECTIONS += "sbc314"
BBFILE_PATTERN_sbc314 := "^${LAYERDIR}/"
BBFILE_PRIORITY_sbc314 = "5"

#Layers to be added when the build is set up

LAYERDEPENDS_sbc314   = "core"
LAYERDEPENDS_sbc314  += "openembedded-layer"
LAYERDEPENDS_sbc314  += "freescale-layer"
LAYERDEPENDS_sbc314  += "networking-layer"
LAYERDEPENDS_sbc314  += "filesystems-layer"
LAYERDEPENDS_sbc314  += "xfce-layer"
LAYERDEPENDS_sbc314  += "multimedia-layer"
```

## conf/machine/include/sbc314-common.inc
```bitbake
# Common machine settings between SBC314 variants

SOURCE_MIRROR_URL ?= "http://git.freescale.com/source/"

JFFS2_ERASEBLOCK = "0x10000"

IMAGE_FSTYPES ?= "tar.gz ext2.gz ext2.gz.u-boot"

MACHINE_EXTRA_RRECOMMENDS += " \
	cpldirqc-module \
	cpldgpio-module \
	udev-extraconf \
"

XSERVER = " \
        mesa-driver-swrast \
        xf86-video-modesetting \
	xf86-video-fbdev \
	xf86-video-ati \
        xf86-input-evdev \
        xf86-input-keyboard \
        xf86-input-mouse \
	xserver-xorg \
        xserver-xorg-extension-glx \
"

# Abaco ships u-boot as a seperate release and we can't build
# it in tree as GCC7 is too new for our branch

EXTRA_IMAGEDEPENDS_remove ="u-boot"

JFFS2_ERASEBLOCK = "0x10000"

USE_VT ?= "0"

PREFERRED_PROVIDER_virtual/kernel = "linux-qoriq-abaco"
```

## conf/machine/sbc314-t1042-xmcga8.conf
```bitbake
MACHINEOVERRIDES =. "t1:t1042:"

require conf/machine/include/e5500-64b.inc

require conf/machine/include/sbc314-common.inc
require conf/machine/include/xmcga8.inc

KERNEL_DEFCONFIG ?= "${S}/arch/powerpc/configs/abaco_sbc314_t1042_xcmga8_defconfig"
KERNEL_DEVICETREE ?= "abaco/sbc314-t1042.dtb"
```

## conf/machine/sbc314-t1042.conf
```bitbake
MACHINEOVERRIDES =. "t1:t1042:"
SERIAL_CONSOLES ?= "115200;ttyS0"
SERIAL_CONSOLES_CHECK ?= "${SERIAL_CONSOLES}"


require conf/machine/include/e5500-64b.inc

require conf/machine/include/sbc314-common.inc

KERNEL_DEVICETREE ?= "abaco/sbc314-t1042.dtb"
KERNEL_DEFCONFIG ?= "${S}/arch/powerpc/configs/abaco/sbc314/corenet64_fmanv3l_smp_defconfig"
```

## conf/machine/sbc314-t2081-xmcga8.conf
```bitbake
#@TYPE: Machine
#@NAME: SBC314 (T2081)
#@SOC: t2081
#@DESCRIPTION: Machine configuration for running T2081 in 64-bit mode on sbc314 with Abaco graphics support
#@MAINTAINER: Steve Reynolds 

require conf/machine/sbc314-t2081.conf
require conf/machine/include/xmcga8.conf

KERNEL_DEFCONFIG = "${S}/arch/powerpc/configs/abaco_sbc314_t2081_xcmga8_defconfig"
```

## conf/machine/sbc314-t2081.conf
```bitbake
MACHINEOVERRIDES =. "t2:t2080:"
SERIAL_CONSOLES ?= "115200;ttyS0"
SERIAL_CONSOLES_CHECK ?= "${SERIAL_CONSOLES}"


require conf/machine/include/e6500-64b.inc

require conf/machine/include/sbc314-common.inc

KERNEL_DEVICETREE ?= "abaco/sbc314-t2081.dtb"
KERNEL_DEFCONFIG ?= "${S}/arch/powerpc/configs/abaco/sbc314/corenet64_fmanv3h_smp_defconfig"
```
